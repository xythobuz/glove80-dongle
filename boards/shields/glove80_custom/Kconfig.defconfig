## boards/shields/glove80_custom/Kconfig.defconfig
```kconfig
if SHIELD_GLOVE80_CUSTOM

config ZMK_SPLIT_ROLE_CENTRAL
    default n

config ZMK_SPLIT_BLE_ROLE_CENTRAL
    default n

config ZMK_SPLIT
    default y

config ZMK_BATTERY_REPORTING_SPLIT_REPORT_LOWEST_CHARGE
    default n

endif
```

## boards/shields/glove80_custom/Kconfig.shield
```kconfig
# No whitespace after the comma or in the keyboard name!
config SHIELD_GLOVE80_CUSTOM
    def_bool $(shields_list_contains,glove80_custom)
```

## boards/shields/glove80_dongle/Kconfig.defconfig
```kconfig
if SHIELD_GLOVE80_DONGLE

# Max 16 characters in keyboard name
config ZMK_KEYBOARD_NAME
    default "G80 Dongle"

config ZMK_SPLIT_ROLE_CENTRAL
    default y

config ZMK_SPLIT_BLE_ROLE_CENTRAL
    default y

config ZMK_SPLIT
    default y

# For Glove80 which has left and right halves
config ZMK_SPLIT_BLE_CENTRAL_PERIPHERALS
    default 2

# Set this to ZMK_SPLIT_BLE_CENTRAL_PERIPHERALS + desired BT profiles
config BT_MAX_CONN
    default 7

# Set this to the same number as BT_MAX_CONN
config BT_MAX_PAIRED
    default 7

endif
```

## boards/shields/glove80_dongle/Kconfig.shield
```kconfig
# No whitespace after the comma or in the keyboard name!
config SHIELD_GLOVE80_DONGLE
    def_bool $(shields_list_contains,glove80_dongle)
```

## config/west.yml
```yaml
manifest:
  defaults:
    revision: main
  remotes:
    - name: zmkfirmware
      url-base: https://github.com/zmkfirmware
    - name: moergo-sc
      url-base: https://github.com/moergo-sc
    - name: zampierilucas
      url-base: https://github.com/zampierilucas
  projects:
    - name: zmk
      remote: zampierilucas
      revision: feat/individual-hid-battery-reporting
      import: app/west.yml
  self:
    path: config
```
